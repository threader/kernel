## arch/arm64/Kconfig.rej
```kconfig
--- arch/arm64/Kconfig
+++ arch/arm64/Kconfig
@@ -1,6 +1,7 @@
 config ARM64
 	def_bool y
 	select ARCH_HAS_ATOMIC64_DEC_IF_POSITIVE
+	select ARCH_SUPPORTS_ATOMIC_RMW
 	select ARCH_WANT_OPTIONAL_GPIOLIB
 	select ARCH_WANT_COMPAT_IPC_PARSE_VERSION
 	select ARCH_WANT_FRAME_POINTERS
```

## drivers/char/Kconfig.rej
```kconfig
--- drivers/char/Kconfig
+++ drivers/char/Kconfig
@@ -579,10 +579,12 @@ config TELCLOCK
 	  controlling the behavior of this hardware.
 
 config DEVPORT
-	bool
-	depends on !M68K
+	bool "/dev/port character device"
 	depends on ISA || PCI
 	default y
+	help
+	  Say Y here if you want to support the /dev/port device. The /dev/port
+	  device is similar to /dev/mem, but for I/O ports.
 
 source "drivers/s390/char/Kconfig"
 
```

## drivers/input/Kconfig.rej
```kconfig
--- drivers/input/Kconfig
+++ drivers/input/Kconfig
@@ -175,15 +175,12 @@ config INPUT_APMPOWER
 	  module will be called apm-power.
 
 config INPUT_KEYRESET
-	tristate "Reset key"
+	bool "Reset key"
 	depends on INPUT
 	select INPUT_KEYCOMBO
 	---help---
 	  Say Y here if you want to reboot when some keys are pressed;
 
-	  To compile this driver as a module, choose M here: the
-	  module will be called keyreset.
-
 config INPUT_KEYCOMBO
 	tristate "Key combo"
 	depends on INPUT
```

## drivers/misc/Kconfig.rej
```kconfig
--- drivers/misc/Kconfig
+++ drivers/misc/Kconfig
@@ -542,7 +542,7 @@ config SRAM
 	  areas found on many SoCs.
 
 config UID_SYS_STATS
-	tristate "Per-UID statistics"
+	bool "Per-UID statistics"
 	depends on PROFILING
 	help
 	  Per UID based cpu time statistics exported to /proc/uid_cputime
--- drivers/misc/Kconfig
+++ drivers/misc/Kconfig
@@ -543,7 +543,7 @@ config SRAM
 
 config UID_SYS_STATS
 	bool "Per-UID statistics"
-	depends on PROFILING
+	depends on PROFILING && TASK_XACCT && TASK_IO_ACCOUNTING
 	help
 	  Per UID based cpu time statistics exported to /proc/uid_cputime
 	  Per UID based io statistics exported to /proc/uid_io
```

## lib/Kconfig.debug.rej
```kconfig
--- lib/Kconfig.debug
+++ lib/Kconfig.debug
@@ -541,24 +541,6 @@ config DEBUG_KMEMLEAK_DEFAULT_OFF
 	  Say Y here to disable kmemleak by default. It can then be enabled
 	  on the command line via kmemleak=on.
 
-config DEBUG_TASK_STACK_SCAN_OFF
-	bool "Disable kmemleak task stack scan by default"
-	depends on DEBUG_KMEMLEAK
-	help
-	  Say Y here to disable kmemleak task stack scan by default
-	  at compile time. It can be enabled later if required by
-	  writing to the debugfs entry :
-	  echo "stack=on" > /sys/kernel/debug/kmemleak.
-
-config DEBUG_MODULE_SCAN_OFF
-	bool "Disable module memory scan for leaks by default"
-	depends on DEBUG_KMEMLEAK
-	help
-	  Say Y here to disable scanning kernel modules area list
-	  by default for memory leaks. Module scan an potentially
-	  run with irq/preemption disabled for considerable amount
-	  of time.
-
 config DEBUG_PREEMPT
 	bool "Debug preemptible kernel"
 	depends on DEBUG_KERNEL && PREEMPT && TRACE_IRQFLAGS_SUPPORT
```

## mm/Kconfig.rej
```kconfig
--- mm/Kconfig
+++ mm/Kconfig
@@ -584,9 +584,6 @@ config PROCESS_RECLAIM
 	 (echo anon > /proc/PID/reclaim) reclaims anonymous pages only.
 	 (echo all > /proc/PID/reclaim) reclaims all pages.
 
-	 (echo addr size-byte > /proc/PID/reclaim) reclaims pages in
-	 (addr, addr + size-bytes) of the process.
-
 	 Any other vaule is ignored.
 
 config ZPOOL
--- mm/Kconfig
+++ mm/Kconfig
@@ -573,19 +573,6 @@ config KSWAPD_CPU_AFFINITY_MASK
 	  For example to limit kswapd to the first 4 cores use the following:
 	  CONFIG_KSWAPD_CPU_AFFINITY_MASK="f"
 
-config PROCESS_RECLAIM
-	bool "Enable process reclaim"
-	depends on PROC_FS
-	default n
-	help
-	 It allows to reclaim pages of the process by /proc/pid/reclaim.
-
-	 (echo file > /proc/PID/reclaim) reclaims file-backed pages only.
-	 (echo anon > /proc/PID/reclaim) reclaims anonymous pages only.
-	 (echo all > /proc/PID/reclaim) reclaims all pages.
-
-	 Any other vaule is ignored.
-
 config ZPOOL
 	tristate "Common API for compressed memory storage"
 	default n
--- mm/Kconfig
+++ mm/Kconfig
@@ -625,8 +625,17 @@ config VM_MAX_READAHEAD
 	  read throughput and thus early boot performance.
 
 config FORCE_RECLAIM
-	bool "Enable forced process reclaim"
-	depends on PROC_FS && PROCESS_RECLAIM
-	default n
+	bool "Enable process reclaim"
+	depends on PROC_FS
+	default y
 	help
 	 It allows to force reclaim pages of all processes by /proc/pid/reclaim.
+
+	 (echo file > /proc/PID/reclaim) reclaims file-backed pages only.
+	 (echo anon > /proc/PID/reclaim) reclaims anonymous pages only.
+	 (echo all > /proc/PID/reclaim) reclaims all pages.
+
+	 (echo addr size-byte > /proc/PID/reclaim) reclaims pages in
+	 (addr, addr + size-bytes) of the process.
+
+	 Any other value is ignored.
--- mm/Kconfig
+++ mm/Kconfig
@@ -623,19 +623,3 @@ config VM_MAX_READAHEAD
 	  This sets the VM_MAX_READAHEAD value to allow the readahead window
 	  to grow to a maximum size of configured. This will benefit sequential
 	  read throughput and thus early boot performance.
-
-config FORCE_RECLAIM
-	bool "Enable process reclaim"
-	depends on PROC_FS
-	default y
-	help
-	 It allows to force reclaim pages of all processes by /proc/pid/reclaim.
-
-	 (echo file > /proc/PID/reclaim) reclaims file-backed pages only.
-	 (echo anon > /proc/PID/reclaim) reclaims anonymous pages only.
-	 (echo all > /proc/PID/reclaim) reclaims all pages.
-
-	 (echo addr size-byte > /proc/PID/reclaim) reclaims pages in
-	 (addr, addr + size-bytes) of the process.
-
-	 Any other value is ignored.
```
